## config/boards/shields/keyboard_split/Kconfig.defconfig
```kconfig
if SHIELD_KEYBOARD_SPLIT

config ZMK_KEYBOARD_NAME
    default "keyboard_split"

endif
```

## config/boards/shields/keyboard_split/Kconfig.shield
```kconfig
config SHIELD_KEYBOARD_SPLIT_LEFT
    def_bool $(shields_list_contains,keyboard_split_left)

config SHIELD_KEYBOARD_SPLIT_RIGHT
    def_bool $(shields_list_contains,keyboard_split_right)
```
